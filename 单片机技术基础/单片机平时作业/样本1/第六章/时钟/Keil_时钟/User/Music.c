#include "Music.h"

// 蜂鸣器端口定义
sbit Buzzer = P2^0;

// 索引与频率对照表（12MHz晶振）
unsigned int code FreqTable[]={
	0,
	63628,63731,63835,63928,64021,64103,64185,64260,64331,64400,64463,64528,
	64580,64633,64684,64732,64777,64820,64860,64898,64934,64968,65000,65030,
	65058,65085,65110,65134,65157,65178,65198,65217,65235,65252,65268,65283,
};

// 晴天
unsigned char code Music_QingTian[]={
    M3, 2, M2, 2, M4, 2, M3, 4, M1, 2, M5, 2, M7, 2, 
    H1, 2, M7, 2, M1, 2, M1, 4, 
	M1, 2, M6, 2, M6, 2, V0, 2, M6, 2, M5, 2, M5, 4, 
    M5, 2, M4, 2, M3, 2, M2, 2, M3, 2, M4, 2, M3, 10,   
    M3, 2, M4_, 2, M5_, 2, M3, 4, M4, 2, M5, 2, M7, 2, 
    H2, 2, M7, 2, H1, 2, H1, 6, V0, 2, 
	H1, 2, H1, 2, M5, 2, M5, 2, M6, 2, M5, 1, M4, 1, M4, 2, 
    M2, 2, M3, 2, M4, 2, M5, 2, M6, 2, M1, 2, 
	M6, 3, M7, 1, M7, 4, 
    M3, 2, M2, 2, M4, 2, M3, 4, M1, 2, M5, 2, M7, 2, 
    H1, 2, M7, 2, M1, 2, M1, 4, 
    M1, 2, M6, 2, M6, 2, V0, 2, M6, 2, M5, 2, M5, 4, 
    M5, 2, M4, 2, M3, 2, M2, 2, M3, 2, M4, 2, M3, 10, 
    M3, 2, M4_, 2, M5_, 2, M3, 4, 
    M4, 2, M5, 2, M7, 2, H2, 2, M7, 2, H1, 2, H1, 6, V0, 2, 
    H1, 2, H1, 2, M5, 2, M5, 2, M6, 2, M5, 2,
    M4, 2, L6, 2, L7, 2, M1, 2, M2, 2, M3, 2, M2, 6, 
    M3, 2, M1, 10, 
    V0, 8, 0xFF
};

// 花海
unsigned char code Music_HuaHai[]={
	M1,2,  M2,2,  M3,2,  M5,1,  M5,9,
    M3,2,  M2,2,  M1,2,  M2,1,  M3,9,
    M1,2,  M2,2,  M3,2,  M7,1,  H1,7,
    H1,2,  M7,2,  M6,2,  M5,2,  M6,1,  M6,2,  M5,7,
    M1,2,  M2,2,  M3,2,  M5,1,  M5,9,
    M3,2,  M2,2,  M1,2,  M2,1,  M1,9,
    M1,2,  M2,2,  M3,2,  M5,2,  M5,2,  M4,2,  M4,2,  M3,2, 
    H1,4,  M3,2,  M3,2,  M2,8,
    M1,2,  M2,2,  M3,2,  M5,1,  M5,9,
    M3,2,  M2,2,  M1,2,  M2,1,  M3,9,
    M1,2,  M2,2,  M3,2,  M7,1,  H1,7,
    H1,2,  M7,2,  M6,2,  M5,2,  M6,1,  M6,2,  M5,7,
    M1,2,  M2,2,  M3,2,  M5,1,  M5,9,
    M3,2,  M2,2,  M1,2,  M2,1,  M1,9,
    M1,2,  M2,2,  M3,2,  M5,1,  M1,9,
    M1,2,  L7,2,  L6,2,  L7,1,  M1,9,
    V0,8, 0xFF
};

// 爱错
unsigned char code Music_AiCuo[]={

    H1, 2, H1, 2, H1, 2, M7, 2, M6, 2, M5, 6,
    M5, 2, M4, 2, M3, 2, M2, 2, M1, 4,
    H1, 2, H1, 2, H1, 2, M7, 2, 
	M6, 2, M5, 4, M4, 2, M3, 2, M2, 8,     
    H1, 2, H1, 2, H1, 2, M7, 2, M6, 2, M5, 4, 
    M6, 2, M7, 2, H1, 4, H2, 2, H1, 2, H3, 4, H1, 1, H2, 8,      
    H3, 2, H2, 2, H1, 2, H2, 4, H1, 1, M6, 5,  
    H3, 2, H2, 2, H1, 2, H1, 2, H1, 2, H2, 2, H3, 2, H2, 10, H3, 6,  
 	M6, 2, H1, 2, H2, 2, H3, 2, H4, 4, H3, 6, 
    H1, 2, H2, 2, H3, 2, H4, 4, H3, 6, 
    H1, 2, H2, 2, H3, 2, H4, 4, H3, 6, 
    H2, 2, H1, 2, M6, 2, H1, 4, H2, 4, 
	M5, 2, H1, 2, H2, 2, H3, 2, H4, 4, H3, 6,     
    H2, 2, H1, 2, H3, 2, H2, 4, H1, 6, 
    H2, 2, H1, 2, M6, 2, H1, 2, H2, 2, H1, 2, M6, 2, H1, 2, 
    H3, 2, H2, 2, H1, 2, H2, 6, 
	H2, 3, H1, 1, H1, 16, 
    V0,16, 0xFF
};

// 雨爱
unsigned char code Music_YuAi[]={

	M1, 2, L6, 2, L7, 4, M1, 4, M3, 8, V0, 4, 
	M5, 1, M5, 3, M3, 4, V0, 3, L5, 1, M3, 1, M2, 1, M1, 2, 
	M2, 2, L7, 6, V0, 4, V0, 2, M1, 2, L7, 2, L6, 2, V0, 4, 
	M1, 2, L6, 2, L7, 4, M1, 4, M3, 8, V0, 4, 
	M5, 1, M6, 3, M3, 4, V0, 3, L5, 1, M5, 1, M4, 2, 
	M3, 3, M1, 4, M2, 6, V0, 2, M3, 2, M2, 2, M1, 2, 
	L6, 2, L5, 2, L6, 2, L5, 1, L6, 3, M3, 2, V0, 2, 
	L5, 2, L6, 2, L5, 2, L6, 2, L5, 1, L6, 3, M3, 2, V0, 2, 
	M3, 2, M3, 2, M2, 2, M2, 2, M1, 1, M1, 3, M2, 2, V0, 2, 
	M4, 4, M3, 2, M4, 2, M5, 6, 
	V0, 1, M3, 1, M2, 1, M1, 1, M2, 2, M3, 2, V0, 1, 
	M3, 1, M2, 1, M1, 1, M2, 2, M3, 2, V0, 2, 
	M3, 1, M3, 1, M3, 2, M3, 1, M3, 2, M4, 2, M5, 3, 
	M3, 2, M2, 2, M3, 2, M2, 2, M1, 1, M1, 5, V0, 2, 
	M1, 2, M2, 2, M3, 2, M4, 2, M3, 2, M4, 2, M5, 4, M3, 2, V0, 2, 
	L5, 2, M5, 6, M1, 2, L7, 3, M1, 1, V0, 2, 
	M6, 2, M5, 6, M1, 2, L7, 3, M1, 1, V0, 2, 
	M2, 1, M3, 1, M3, 3, L6, 2, M1, 2, V0, 2, 
	M1, 2, L7, 2, M1, 2, M6, 4, M5, 2, M5, 6, 
	V0, 8, 0xFF
};

// 4首歌曲列表
unsigned char code *MusicList[]={
    Music_QingTian,
    Music_HuaHai,
    Music_AiCuo,
    Music_YuAi
};

// 英文歌曲名
unsigned char code SongNames[][10]={
    "QingTian",
    "HuaHai  ",
    "AiCuo   ",
    "YuAi    "
};

// 全局音乐变量
unsigned char CurrentSong = 0;    // 当前选中铃声
unsigned char MusicSelect = 0;    // 音乐播放指针
unsigned int NoteTimer = 0;       // 音符时长计数器
bit IsPlaying = 0;                // 音乐播放标志
bit NoteChanged = 0;              // 音符切换标志
unsigned char CurrentFreq = 0;    // 当前播放音符

/*********************************************************/
// 音乐系统初始化（双定时器配置）
// 定时器0：产生音符频率（16位自动重装）
// 定时器1：计时音符时长（1ms中断）
/*********************************************************/
void Music_Init(void)
{
    // 配置定时器0（模式1，16位定时器）
    TMOD &= 0xF0;
    TMOD |= 0x01;
    TL0 = 0x18;
    TH0 = 0xFC;
    TF0 = 0;
    TR0 = 0;
    ET0 = 1;
    
    // 配置定时器1（模式1，16位定时器，1ms@12MHz）
    TMOD &= 0x0F;
    TMOD |= 0x10;
    TL1 = 0x18;
    TH1 = 0xFC;
    TF1 = 0;
    TR1 = 1;
    ET1 = 1;
    
    // 开启总中断
    EA = 1;
    // 设置中断优先级
    PT0 = 1;  // 频率定时器优先级高
    PT1 = 0;
}

/*********************************************************/
// 开始播放指定歌曲
/*********************************************************/
void Music_Play(unsigned char song)
{
    Music_Stop();
    CurrentSong = song;
    MusicSelect = 0;
    NoteTimer = 0;
    NoteChanged = 1;  // 强制加载第一个音符
    IsPlaying = 1;
    TR0 = 1;
}

/*********************************************************/
// 停止播放音乐
/*********************************************************/
void Music_Stop(void)
{
    TR0 = 0;
    IsPlaying = 0;
    Buzzer = 0;  // 确保蜂鸣器关闭
}

/*********************************************************/
// 定时器0中断服务函数（产生音符频率）
/*********************************************************/
void Timer0_Routine() interrupt 1
{
    if(IsPlaying && FreqTable[CurrentFreq])
    {
        // 重设定时器初值为对应音符的频率
        TL0 = FreqTable[CurrentFreq] % 256;
        TH0 = FreqTable[CurrentFreq] / 256;
        // 翻转蜂鸣器电平产生方波
        Buzzer = !Buzzer;
    }
    else
    {
        // 休止符时保持蜂鸣器关闭
        Buzzer = 0;
    }
}

/*********************************************************/
// 定时器1中断服务函数（1ms计时，处理音符时长）
/*********************************************************/
void Timer1_Routine() interrupt 3
{
    // 重设定时器初值
    TL1 = 0x18;
    TH1 = 0xFC;
    
    if(IsPlaying)
    {
        NoteTimer++;
        
        // 加载新音符
        if(NoteChanged)
        {
            NoteChanged = 0;
            
            // 检查是否到歌曲结束
            if(MusicList[CurrentSong][MusicSelect] == 0xFF)
            {
                // 歌曲播放完自动从头开始循环
                MusicSelect = 0;
            }
            
            // 读取音符（第一个字节是音符）
            CurrentFreq = MusicList[CurrentSong][MusicSelect++];
            // 读取时长（第二个字节是时长）
            // 注意：MusicSelect现在指向时长
        }
        
        // 检查当前音符是否播放完毕
        if(NoteTimer >= (SPEED/4 * MusicList[CurrentSong][MusicSelect]))
        {
            // 音符播放完毕，指向下一个音符
            MusicSelect++;
            NoteTimer = 0;
            NoteChanged = 1;
            
            // 音符间短暂停顿(5ms)
            TR0 = 0;
            Buzzer = 0;
        }
        
        // 停顿时间到，恢复播放
        if(NoteTimer >= 5 && !TR0)
        {
            TR0 = 1;
        }
    }
}