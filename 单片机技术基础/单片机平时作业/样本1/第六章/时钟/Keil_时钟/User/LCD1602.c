#include "LCD1602.h"                                      //包含LCD1602头文件

/*********************************************************/
// 1602液晶写命令函数，cmd就是要写入的命令
/*********************************************************/
void WriteLcdCmd(uchar cmd)
{ 
	RS = 0;                                               //数据命令选择引脚置为低电平，选择写入命令
	RW = 0;                                               //读写选择引脚置为低电平，选择写入
	EN = 0;                                               //使能引脚置为低电平
	P0=cmd;                                               //要写入的命令赋值给P0端口
	DelayMs(2);                                           //延时2ms
	EN = 1;                                               //使能引脚置为高电平
	DelayMs(2);                                           //延时2ms
	EN = 0;	                                              //使能引脚置为低电平
}
/*********************************************************/
// 1602液晶写数据函数，dat就是要写入的数据
/*********************************************************/
void WriteLcdData(uchar dat)
{
	RS = 1;                                               //数据命令选择引脚置为高电平，选择写入数据
	RW = 0;                                               //读写选择引脚置为低电平，选择写入
	EN = 0;                                               //使能引脚置为低电平
	P0=dat;                                               //要写入的数据赋值给P0端口
	DelayMs(2);                                           //延时2ms
	EN = 1;                                               //使能引脚置为高电平 
	DelayMs(2);                                           //延时2ms
	EN = 0;                                               //使能引脚置为低电平
}

/*********************************************************/
// 液晶坐标设置函数
/*********************************************************/
void SetLcdCursor(unsigned char line, unsigned char column)
{
    if(line == 0)                                         //判断是否为第一行
        WriteLcdCmd(column + 0x80);                       //若是，写入第一行列坐标
    if(line == 1)                                         //判断是否为第二行
        WriteLcdCmd(column + 0x80 + 0x40);                //若是，写入第二行列坐标
}
/*********************************************************/
// 液晶显示字符串函数
/*********************************************************/
void ShowLcdStr(unsigned char *str)
{
    while(*str != '\0')                                  //当没有指向结束符
        WriteLcdData(*str++);                            //字符指针加1
}
/*********************************************************/
// 液晶输出数字
/*********************************************************/
void ShowLcdNum(unsigned char num)
{
    WriteLcdData(num/10 + 48);                            //分离出十位
    WriteLcdData(num%10 + 48);                            //分离出个位
}
/*********************************************************/
// 液晶初始化函数
/*********************************************************/
void LcdInit()
{
    WriteLcdCmd(0x38);                                    //16*2显示，5*7点阵，8位数据口
    WriteLcdCmd(0x06);                                    //地址加1，当写入数据后光标右移
    WriteLcdCmd(0x0c);                                    //开显示，不显示光标
    WriteLcdCmd(0x01);                                    //清屏
}